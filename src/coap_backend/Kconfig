## src/coap_backend/Kconfig
```kconfig
#
# Copyright (c) 2020 Nordic Semiconductor
#
# SPDX-License-Identifier: LicenseRef-BSD-5-Clause-Nordic
#

menuconfig COAP_BACKEND
	bool "COAP backend library"
	select COAP
	select NET_SOCKETS
	select NET_SOCKETS_POSIX_NAMES

if COAP_BACKEND

config COAP_BACKEND_RESOURCE
	string "CoAP resource - defaults to Californium observable resource"
	default "obs"

config COAP_BACKEND_SERVER_HOST_NAME
	string "CoAP server hostname"
	default "californium.eclipse.org"

config COAP_BACKEND_SERVER_PORT
	int "CoAP server port"
	default 5683

config COAP_BACKEND_DTLS_ENABLE
	bool ""
	select NET_SOCKETS_SOCKOPT_TLS
	select NET_SOCKETS_ENABLE_DTLS

config COAP_BACKEND_SEC_TAG
	int ""
	default 200

config COAP_BACKEND_KEEPALIVE
	int ""
	default 1200

config COAP_BACKEND_RX_TX_BUFFER_LEN
	int "Buffer sizes for the UDP backend."
	default 1024
	help
	  Specifies maximum message size can be transmitted/received

module=COAP_BACKEND
module-dep=LOG
module-str=CoAP backend
source "${ZEPHYR_BASE}/subsys/logging/Kconfig.template.log_config"

endif # COAP_BACKEND
```

## src/mqtt_backend/Kconfig
```kconfig
#
# Copyright (c) 2020 Nordic Semiconductor
#
# SPDX-License-Identifier: LicenseRef-BSD-5-Clause-Nordic
#

menuconfig MQTT_BACKEND
	bool "MQTT Backend"
	select MQTT_LIB
	select MQTT_LIB_TLS if MQTT_BACKEND_TLS_ENABLE

if MQTT_BACKEND

config MQTT_BACKEND_TLS_ENABLE
	bool "Use TLS secured connection"

config MQTT_BACKEND_STATIC_IPV4
	bool "Enable use of static IPv4"

config MQTT_BACKEND_STATIC_IPV4_ADDR
	string "Static IPv4 address"
	depends on MQTT_BACKEND_STATIC_IPV4

config MQTT_BACKEND_SEC_TAG
	int "Security tag to use for MQTT connection"

config MQTT_BACKEND_BROKER_HOST_NAME
	string "MQTT broker server hostname"

config MQTT_BACKEND_BROKER_PORT
	int "MQTT broker port"
	default 8883

config MQTT_BACKEND_MQTT_RX_TX_BUFFER_LEN
	int "Buffer sizes for the MQTT library."
	default 512
	help
	  Specifies maximum message size can be transmitted/received through
	  MQTT (exluding MQTT PUBLISH payload).

config MQTT_BACKEND_MQTT_PAYLOAD_BUFFER_LEN
	int "Size of the MQTT PUBLISH payload buffer (receiving MQTT messages)."
	default 512

config MQTT_BACKEND_IPV6
	bool "Configure MQTT backend to use IPv6 addressing. Otherwise IPv4 is used."

config MQTT_BACKEND_CLIENT_ID_MAX_LEN
	int "Maximum length of cliend id"
	default 20

config MQTT_BACKEND_CLIENT_ID_STATIC
	string "Static client id"
	default "my-thing"

module=MQTT_BACKEND
module-dep=LOG
module-str=MQTT Backend
source "${ZEPHYR_BASE}/subsys/logging/Kconfig.template.log_config"

endif # MQTT_BACKEND
```
