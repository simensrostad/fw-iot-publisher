## CMakeLists.txt
```
#
# Copyright (c) 2020 Nordic Semiconductor
#
# SPDX-License-Identifier: LicenseRef-BSD-5-Clause-Nordic
#

cmake_minimum_required(VERSION 3.8.2)

include(../nrf/cmake/boilerplate.cmake NO_POLICY_SCOPE)

include($ENV{ZEPHYR_BASE}/cmake/app/boilerplate.cmake NO_POLICY_SCOPE)
project(iot_publisher)

# NORDIC SDK APP START
target_sources(app PRIVATE src/main.c)
# NORDIC SDK APP END

zephyr_include_directories(src)

add_subdirectory(src/coap_backend)
add_subdirectory(src/mqtt_backend)
```

## Kconfig
```
#
# Copyright (c) 2020 Nordic Semiconductor ASA
#
# SPDX-License-Identifier: LicenseRef-BSD-5-Clause-Nordic
#

menu "IoT Publisher Sample Settings"

rsource "src/mqtt_backend/Kconfig"

rsource "src/coap_backend/Kconfig"

config CLOUD_BACKEND
	string "String that selects the cloud backend to be used"
	default "NRF_CLOUD"

config CLOUD_MESSAGE
	string "Custom message published periodically to cloud"
	default "{\"tmp\":{\"val\":23,\"ts\":735181200}}"

config CLOUD_MESSAGE_PUBLICATION_INTERVAL
	int "How often the custom message should be published to cloud, in seconds"
	default 10

choice
	prompt "Cloud Publication Trigger"
	default CLOUD_PUBLICATION_BUTTON_PRESS

config CLOUD_PUBLICATION_BUTTON_PRESS
	bool "Trigger publication to cloud upon a button press"

config CLOUD_PUBLICATION_SEQUENTIAL
	bool "Sequential publication to cloud set by the CONFIG_MESSAGE_PUBLICATION_INTERVAL option"

endchoice

config POWER_SAVING_MODE_ENABLE
	bool "Request PSM from cellular network"

config LTE_RAI_NO_RESPONSE
	bool "Request Release assistance indication"

endmenu

menu "Zephyr Kernel"
source "$ZEPHYR_BASE/Kconfig.zephyr"
endmenu
```

## sample.yaml
```
sample:
  name: IoT Publisher sample
tests:
  test_build:
    build_only: true
    build_on_all: true
    platform_whitelist: nrf9160_pca10090ns nrf9160_pca20035ns
    tags: ci_build
```

## west.yml
```
manifest:
  remotes:
    - name: nordic
      url-base: https://github.com/NordicPlayground
  projects:
    - name: fw-nrfconnect-nrf
      path: nrf
      remote: nordic
      revision: b645926ab1aab57b1569a5473c4b52a2c28cf880
      import: true
  self:
    path: iot_publisher
```

## prj.conf
```kconfig
#
# Copyright (c) 2020 Nordic Semiconductor ASA
#
# SPDX-License-Identifier: LicenseRef-BSD-5-Clause-Nordic
#

# General config
CONFIG_NEWLIB_LIBC=y
CONFIG_RESET_ON_FATAL_ERROR=n
CONFIG_NCS_SAMPLES_DEFAULTS=y

# Network
CONFIG_NETWORKING=y
CONFIG_NET_NATIVE=n
CONFIG_NET_SOCKETS=y
CONFIG_NET_SOCKETS_OFFLOAD=y

# LTE link control
CONFIG_LTE_LINK_CONTROL=y
CONFIG_LTE_NETWORK_MODE_LTE_M=y
CONFIG_LTE_AUTO_INIT_AND_CONNECT=n

# BSD library
CONFIG_BSD_LIBRARY=y

# DK
CONFIG_DK_LIBRARY=y

# Heap and Stack sizes
CONFIG_HEAP_MEM_POOL_SIZE=8192
CONFIG_MAIN_STACK_SIZE=4096
CONFIG_SYSTEM_WORKQUEUE_STACK_SIZE=4096

# Generic cloud API
CONFIG_CLOUD_API=y

# nRF Cloud
CONFIG_NRF_CLOUD=y

# Test parameters
#################

# Cloud Backend
CONFIG_CLOUD_BACKEND="MQTT_BACKEND"

CONFIG_CLOUD_MESSAGE="{\"dev\":{\"v\":{\"band\":3,\"nw\":\"NB-IoT GPS\",\"iccid\":\"89450421180216254864\",\"modV\":\"mfw_nrf9160_1.1.0-40.rc\",\"brdV\":\"nrf9160_pca10090\",\"appV\":\"1.0.2\"},\"ts\":1581412370663},\"roam\":{\"v\":{\"rsrp\":64,\"area\":3305,\"mccmnc\":24202,\"cell\":34237203,\"ip\":\"10.81.160.193\"},\"ts\":1581438337056},\"bat\":{\"v\":4125,\"ts\":1581438332150},\"acc\":{\"v\":[6.442969,7.256921,-1.019891],\"ts\":1574251825404},\"gps\":{\"v\":{\"lng\":10.437156350160675,\"lat\":63.421399614436105,\"acc\":5.192617416381836,\"alt\":152.19400024414062,\"spd\":0.0854216143488884,\"hdg\":0},\"ts\":1581438332000}}"

# MQTT Broker
CONFIG_MQTT_BACKEND=y
CONFIG_MQTT_BACKEND_BROKER_HOST_NAME="vmi36865.contabo.host"
CONFIG_MQTT_BACKEND_BROKER_PORT=1992
CONFIG_MQTT_BACKEND_TLS_ENABLE=y
CONFIG_MQTT_BACKEND_SEC_TAG=201
CONFIG_MQTT_BACKEND_CLIENT_ID_STATIC="iot_publisher"
CONFIG_MQTT_BACKEND_LOG_LEVEL_DBG=y
CONFIG_MQTT_KEEPALIVE=7200

# CoAP Server
CONFIG_COAP_BACKEND=y
CONFIG_COAP_BACKEND_SERVER_HOST_NAME="vmi36865.contabo.host"
CONFIG_COAP_BACKEND_SERVER_PORT=1993
CONFIG_COAP_BACKEND_RESOURCE="iot_publisher"
CONFIG_COAP_BACKEND_DTLS_ENABLE=y
CONFIG_COAP_BACKEND_SEC_TAG=201
CONFIG_COAP_BACKEND_LOG_LEVEL_DBG=y
CONFIG_COAP_BACKEND_KEEPALIVE=7200

# POWER SAVING MODE
CONFIG_POWER_SAVING_MODE_ENABLE=y
CONFIG_LTE_PSM_REQ_RPTAU="00100011"
CONFIG_LTE_PSM_REQ_RAT="00000000"

# eDRX
CONFIG_LTE_EDRX_REQ=n
CONFIG_LTE_EDRX_REQ_VALUE="0010"

# UART / LOGGING / BSD TRACE
CONFIG_BSD_LIBRARY_TRACE_ENABLED=y
CONFIG_AT_HOST_LIBRARY=y
CONFIG_UART_INTERRUPT_DRIVEN=y
```

## src/main.c
```c
/*
 * Copyright (c) 2020 Nordic Semiconductor ASA
 *
 * SPDX-License-Identifier: LicenseRef-BSD-5-Clause-Nordic
 */

#include <zephyr.h>
#include <modem/lte_lc.h>
#include <net/cloud.h>
#include <net/socket.h>
#include <dk_buttons_and_leds.h>

static struct cloud_backend *cloud_backend;
static struct k_delayed_work cloud_update_work;
static struct k_delayed_work cloud_ping_work;

static int packet_count = 0;

static void cloud_update_work_fn(struct k_work *work)
{
	int err;

	printk("Publishing message: %s\n", CONFIG_CLOUD_MESSAGE);
	printk("Packet count: %d\n", packet_count);

	packet_count++;

	struct cloud_msg msg = {
		.qos = CLOUD_QOS_AT_MOST_ONCE,
		.endpoint.type = CLOUD_EP_TOPIC_MSG,
		.buf = CONFIG_CLOUD_MESSAGE,
		.len = sizeof(CONFIG_CLOUD_MESSAGE)-1
	};

	err = cloud_send(cloud_backend, &msg);
	if (err) {
		printk("cloud_send failed, error: %d\n", err);
	}

#if defined(CONFIG_CLOUD_PUBLICATION_SEQUENTIAL)
	k_delayed_work_submit(
			&cloud_update_work,
			K_SECONDS(CONFIG_CLOUD_MESSAGE_PUBLICATION_INTERVAL));
#endif
}

static void cloud_ping_work_fn(struct k_work *work)
{
	int err;

	printk("Pinging cloud!\n");
	err = cloud_ping(cloud_backend);
	if (err) {
		printk("cloud_ping, err: %d\n", err);
	}
}

void cloud_event_handler(const struct cloud_backend *const backend,
			 const struct cloud_event *const evt,
			 void *user_data)
{
	ARG_UNUSED(user_data);
	ARG_UNUSED(backend);

	switch (evt->type) {
	case CLOUD_EVT_CONNECTED:
		printk("CLOUD_EVT_CONNECTED\n");
		break;
	case CLOUD_EVT_READY:
		printk("CLOUD_EVT_READY\n");
#if defined(CONFIG_CLOUD_PUBLICATION_SEQUENTIAL)
		k_delayed_work_submit(&cloud_update_work, K_NO_WAIT);
#endif
		break;
	case CLOUD_EVT_DISCONNECTED:
		printk("CLOUD_EVT_DISCONNECTED\n");
		break;
	case CLOUD_EVT_ERROR:
		printk("CLOUD_EVT_ERROR\n");
		break;
	case CLOUD_EVT_DATA_SENT:
		printk("CLOUD_EVT_DATA_SENT\n");
		break;
	case CLOUD_EVT_DATA_RECEIVED:
		printk("CLOUD_EVT_DATA_RECEIVED\n");
		printk("Data received from cloud: %s\n", evt->data.msg.buf);
		break;
	case CLOUD_EVT_PAIR_REQUEST:
		printk("CLOUD_EVT_PAIR_REQUEST\n");
		break;
	case CLOUD_EVT_PAIR_DONE:
		printk("CLOUD_EVT_PAIR_DONE\n");
		break;
	case CLOUD_EVT_FOTA_DONE:
		printk("CLOUD_EVT_FOTA_DONE\n");
		break;
	default:
		printk("Unknown cloud event type: %d\n", evt->type);
		break;
	}
}

static void work_init(void)
{
	k_delayed_work_init(&cloud_update_work, cloud_update_work_fn);
	k_delayed_work_init(&cloud_ping_work, cloud_ping_work_fn);
}

static void modem_configure(void)
{
#if defined(CONFIG_BSD_LIBRARY)
	if (IS_ENABLED(CONFIG_LTE_AUTO_INIT_AND_CONNECT)) {
		/* Do nothing, modem is already turned on
		 * and connected.
		 */
	} else {
		int err;

		printk("Connecting to LTE network. ");
		printk("This may take several minutes.\n");

#if defined(CONFIG_POWER_SAVING_MODE_ENABLE)
		err = lte_lc_psm_req(true);
		if (err) {
			printk("lte_lc_psm_req, error: %d\n", err);
		}

		printk("PSM mode requested\n");
#else
		err = lte_lc_psm_req(false);
		if (err) {
			printk("lte_lc_psm_req, error: %d\n", err);
		}
#endif
		err = lte_lc_init_and_connect();
		if (err) {
			printk("LTE link could not be established.\n");
		}

		printk("Connected to LTE network\n");
	}
#endif
}

#if defined(CONFIG_CLOUD_PUBLICATION_BUTTON_PRESS)
static void button_handler(u32_t button_states, u32_t has_changed)
{
	if (has_changed & button_states & DK_BTN1_MSK) {
		k_delayed_work_submit(&cloud_update_work, K_NO_WAIT);
	}
}
#endif

void main(void)
{
	int err;

	printk("Cloud client has started\n");

	cloud_backend = cloud_get_binding(CONFIG_CLOUD_BACKEND);
	__ASSERT(cloud_backend != NULL, "%s backend not found",
		 CONFIG_CLOUD_BACKEND);

	printk("Binded to %s\n", CONFIG_CLOUD_BACKEND);

	work_init();
	modem_configure();

#if defined(CONFIG_CLOUD_PUBLICATION_BUTTON_PRESS)
	err = dk_buttons_init(button_handler);
	if (err) {
		printk("dk_buttons_init, error: %d\n", err);
	}
#endif

	err = cloud_init(cloud_backend, cloud_event_handler);
	if (err) {
		printk("Cloud backend could not be initialized, error: %d\n",
			err);
	}

	err = cloud_connect(cloud_backend);
	if (err) {
		printk("cloud_connect, error: %d\n", err);
	}

	struct pollfd fds[] = {
		{
			.fd = cloud_backend->config->socket,
			.events = POLLIN
		}
	};

	while (true) {
		err = poll(fds, ARRAY_SIZE(fds),
			   cloud_keepalive_time_left(cloud_backend));
		if (err < 0) {
			printk("poll() returned an error: %d\n", err);
			continue;
		}

		if (err == 0) {
			cloud_ping(cloud_backend);
			continue;
		}

		if ((fds[0].revents & POLLIN) == POLLIN) {
			cloud_input(cloud_backend);
		}

		if ((fds[0].revents & POLLNVAL) == POLLNVAL) {
			printk("Socket error: POLLNVAL\n");
			printk("The cloud socket was unexpectedly closed.\n");
			return;
		}

		if ((fds[0].revents & POLLHUP) == POLLHUP) {
			printk("Socket error: POLLHUP\n");
			printk("Connection was closed by the cloud.\n");
			return;
		}

		if ((fds[0].revents & POLLERR) == POLLERR) {
			printk("Socket error: POLLERR\n");
			printk("Cloud connection was unexpectedly closed.\n");
			return;
		}
	}

	printk("Closing Cloud connection\n");
	cloud_disconnect(cloud_backend);
}
```
